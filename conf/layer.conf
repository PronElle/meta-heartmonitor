## conf/layer.conf
```bitbake
# We have a conf and classes directory, add to BBPATH
BBPATH .= ":${LAYERDIR}"

# We have recipes-* directories, add to BBFILES
BBFILES += "${LAYERDIR}/recipes-*/*/*.bb \
            ${LAYERDIR}/recipes-*/*/*.bbappend"

BBFILE_COLLECTIONS += "meta-heartmonitor"
BBFILE_PATTERN_meta-heartmonitor = "^${LAYERDIR}/"
BBFILE_PRIORITY_meta-heartmonitor = "6"

LAYERDEPENDS_meta-heartmonitor = "core"
LAYERSERIES_COMPAT_meta-heartmonitor = "dunfell"
```
